## conf/distro/include/versions-23.17-LO_omap-3430sdp.inc
```bitbake
# omap3430 SDP specific versions

# baseport
PREFERRED_VERSION_x-load =             "4.62"
PREFERRED_VERSION_u-boot =             "5.10"
SRCREV_pn-linux-tiomap ?= "02b2ce47a93e32f3b4e26662d78a0f31a6ac37ab"

# bridge and friends
PREFERRED_VERSION_tidspbridge-lib =    "23.17-P3"
PREFERRED_PROVIDER_virtual/dspbridge-driver = "linux-tiomap"
```

## conf/distro/include/versions-23.17-OZ_omap-3430sdp.inc
```bitbake
# omap3430 SDP specific versions

# baseport
PREFERRED_VERSION_x-load =             "4.62"
PREFERRED_VERSION_u-boot =             "5.10"
PREFERRED_VERSION_linux-tiomap =       "2.6.24.7-5.25-P1"

# bridge and friends
PREFERRED_VERSION_tidspbridge-lib =             "23.17-P1"
PREFERRED_VERSION_tidspbridge-module =          "23.17-P1"
PREFERRED_PROVIDER_virtual/dspbridge-driver = "tidspbridge-module"

# tiopenmax
PREFERRED_VERSION_mm-isp =			"1.15"
```

## conf/distro/include/versions-tiopenmax-24.0.12.inc
```bitbake
# openmax
PREFERRED_PROVIDER_virtual/openmax-il =		"meta-tiopenmax-24-modular"
PREFERRED_VERSION_tiopenmax-core =		"git"
PREFERRED_VERSION_tiopenmax-osal =		"git"
PREFERRED_VERSION_tiopenmax-base =		"git"
PREFERRED_VERSION_tiopenmax-base2 =		"24.0.10"
PREFERRED_VERSION_tiopenmax-lcml =		"23.5.0.10"
PREFERRED_VERSION_tiopenmax-audiodecode =       "git"
PREFERRED_VERSION_tiopenmax-audioencode =       "git"
PREFERRED_VERSION_tiopenmax-common =            "23.5.0.10"
PREFERRED_VERSION_tiopenmax-rmproxy =           "23.5.0.10"
PREFERRED_VERSION_tiopenmax-videodec =          "23.5.0.10"
PREFERRED_VERSION_tiopenmax-videoenc =          "23.5.0.10"
PREFERRED_VERSION_tiopenmax-stubcamera = 	"24.0.11"
```
